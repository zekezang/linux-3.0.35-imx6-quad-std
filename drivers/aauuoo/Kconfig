## drivers/aauuoo/Kconfig
```kconfig
##

source "drivers/aauuoo/gpio/Kconfig"

source "drivers/aauuoo/can/Kconfig"

source "drivers/aauuoo/eint/Kconfig"
```

## drivers/aauuoo/classfinddevice/Kconfig
```kconfig
menu "AAUUOO_CLASSFINDDEVICE"

config AAUUOO_CLASSFINDDEVICE
	tristate "CLASSFINDDEVICE zekezang"
	
endmenu
```
